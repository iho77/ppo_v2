## sdkconfig.defaults
```kconfig
# PPO2 HUD Project Configuration

# I2C Configuration
CONFIG_I2C_ENABLE=y

# Display Configuration  
CONFIG_SH1107_I2C_ADDRESS=0x3D
CONFIG_SH1107_I2C_FREQ_HZ=400000

# LVGL Configuration for monochrome SH1107 display
# Use RGB565 color depth even for monochrome displays per LVGL port requirements
CONFIG_LV_COLOR_DEPTH_16=y
# CONFIG_LV_COLOR_DEPTH_1 is not set

# Button Configuration
CONFIG_BUTTON_DEBOUNCE_MS=50
CONFIG_BUTTON_LONG_PRESS_MS=1000

# Logging Configuration
CONFIG_LOG_DEFAULT_LEVEL_INFO=y
CONFIG_LOG_DEFAULT_LEVEL=3

# FreeRTOS Configuration
CONFIG_FREERTOS_HZ=1000

# Memory Configuration
CONFIG_ESP32_DEFAULT_CPU_FREQ_240=y
```
